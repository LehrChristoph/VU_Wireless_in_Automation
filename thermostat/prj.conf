## CMakeLists.txt
```
# SPDX-License-Identifier: Apache-2.0

cmake_minimum_required(VERSION 3.20.0)

find_package(Zephyr REQUIRED HINTS $ENV{ZEPHYR_BASE})
project(thermostat)

target_sources(app PRIVATE src/main.c)
target_sources(app PRIVATE src/hvac.c)
target_sources(app PRIVATE src/coap.c)
target_sources(app PRIVATE src/display.c)
include(${ZEPHYR_BASE}/samples/net/common/common.cmake)

set(gen_dir ${ZEPHYR_BINARY_DIR}/include/generated/)

target_include_directories(app PRIVATE ${ZEPHYR_BASE}/subsys/net/ip)
```

## prj.conf
```kconfig
# General options
CONFIG_FPU=y

# Generic networking options
CONFIG_NETWORKING=y
CONFIG_NET_UDP=y
CONFIG_NET_TCP=y
CONFIG_NET_IPV6=y
CONFIG_NET_IPV4=y
CONFIG_NET_SOCKETS=y
CONFIG_NET_SOCKETS_POSIX_NAMES=y
CONFIG_NET_SOCKETS_POLL_MAX=4
CONFIG_NET_CONNECTION_MANAGER=y

# Kernel options
CONFIG_MAIN_STACK_SIZE=2048
CONFIG_HEAP_MEM_POOL_SIZE=4096
CONFIG_ENTROPY_GENERATOR=y
CONFIG_TEST_RANDOM_GENERATOR=y
CONFIG_INIT_STACKS=y

# Logging
CONFIG_NET_LOG=y
CONFIG_LOG=y
CONFIG_NET_STATISTICS=y
CONFIG_PRINTK=y

# Network buffers
CONFIG_NET_PKT_RX_COUNT=16
CONFIG_NET_PKT_TX_COUNT=16
CONFIG_NET_BUF_RX_COUNT=80
CONFIG_NET_BUF_TX_COUNT=80
CONFIG_NET_CONTEXT_NET_PKT_POOL=y

# IP address options
CONFIG_NET_IF_UNICAST_IPV6_ADDR_COUNT=3
CONFIG_NET_IF_MCAST_IPV6_ADDR_COUNT=10
CONFIG_NET_MAX_CONTEXTS=10

# Network shell
CONFIG_NET_SHELL=y

# The addresses are selected so that qemu<->qemu connectivity works ok.
# For linux<->qemu connectivity, create a new conf file and swap the
# addresses (so that peer address is ending to 2).
CONFIG_NET_CONFIG_SETTINGS=y
CONFIG_NET_CONFIG_NEED_IPV6=y
CONFIG_NET_CONFIG_MY_IPV6_ADDR="2001:db8::2"
CONFIG_NET_CONFIG_PEER_IPV6_ADDR="2001:db8::1"

CONFIG_COAP=y

CONFIG_GPIO=y
```

## overlay-display.conf
```kconfig
CONFIG_LV_Z_MEM_POOL_NUMBER_BLOCKS=8

CONFIG_DISPLAY=y

CONFIG_LVGL=y
CONFIG_LV_MEM_CUSTOM=y
CONFIG_LV_USE_LOG=y
CONFIG_LV_USE_LABEL=y
CONFIG_LV_USE_BTN=y
CONFIG_LV_USE_IMG=y
CONFIG_LV_FONT_MONTSERRAT_14=y

CONFIG_SENSOR=y
```

## src/main.c
```c
/* echo-client.c - Networking echo client */

/*
 * Copyright (c) 2017 Intel Corporation.
 * Copyright (c) 2018 Nordic Semiconductor ASA.
 *
 * SPDX-License-Identifier: Apache-2.0
 */

/*
 * The echo-client application is acting as a client that is run in Zephyr OS,
 * and echo-server is run in the host acting as a server. The client will send
 * either unicast or multicast packets to the server which will reply the packet
 * back to the originator.
 *
 * In this sample application we create four threads that start to send data.
 * This might not be what you want to do in your app so caveat emptor.
 */

#include <zephyr/logging/log.h>
LOG_MODULE_REGISTER(thermostat, LOG_LEVEL_INF);

#include <zephyr/zephyr.h>
#include <errno.h>
#include <stdio.h>
#include <stdlib.h>

#include <zephyr/net/socket.h>
#include <zephyr/net/tls_credentials.h>

#include <zephyr/net/net_mgmt.h>
#include <zephyr/net/net_event.h>
#include <zephyr/net/net_conn_mgr.h>


#ifndef TEMP_MIN
	#define TEMP_MIN 24.0
#endif

#ifndef TEMP_MAX
	#define TEMP_MAX 28.0
#endif

#ifndef TEMP_MIN_PRESENCE
	#define TEMP_MIN_PRESENCE 25.0
#endif

#ifndef TEMP_MAX_PRESENCE
	#define TEMP_MAX_PRESENCE 27.0
#endif

#ifndef HUMIDITY_MAX
	#define HUMIDITY_MAX 75.0
#endif

#ifndef AIQ_MAX
	#define AIQ_MAX 100
#endif

#if defined(CONFIG_USERSPACE)
#include <zephyr/app_memory/app_memdomain.h>
K_APPMEM_PARTITION_DEFINE(app_partition);
struct k_mem_domain app_domain;
#endif

#include "common.h"
#define APP_BANNER "Thermostat"

#define INVALID_SOCK (-1)

#define EVENT_MASK (NET_EVENT_L4_CONNECTED | \
		    NET_EVENT_L4_DISCONNECTED)


APP_DMEM struct configs conf = {
	.ipv6 = {
		.proto = "IPv6",
		.coap.sock = INVALID_SOCK,
	},
};

static APP_BMEM bool connected;
K_SEM_DEFINE(run_app, 0, 1);

static struct net_mgmt_event_callback mgmt_cb;

// Join CoAP Multicast group
static bool join_coap_multicast_group(void)
{
	static struct in6_addr my_addr = MY_IP6ADDR;
	static struct sockaddr_in6 mcast_addr = {
		.sin6_family = AF_INET6,
		.sin6_addr = ALL_NODES_LOCAL_COAP_MCAST,
		.sin6_port = htons(COAP_PORT) };
	struct net_if_addr *ifaddr;
	struct net_if *iface;

	iface = net_if_get_default();
	if (!iface) {
		LOG_ERR("Could not get te default interface\n");
		return false;
	}

#if defined(CONFIG_NET_CONFIG_SETTINGS)
	if (net_addr_pton(AF_INET6,
			  CONFIG_NET_CONFIG_MY_IPV6_ADDR,
			  &my_addr) < 0) {
		LOG_ERR("Invalid IPv6 address %s",
			CONFIG_NET_CONFIG_MY_IPV6_ADDR);
	}
#endif

	ifaddr = net_if_ipv6_addr_add(iface, &my_addr, NET_ADDR_MANUAL, 0);
	if (!ifaddr) {
		LOG_ERR("Could not add unicast address to interface");
		return false;
	}

	ifaddr->addr_state = NET_ADDR_PREFERRED;

	struct net_if_mcast_addr *if_mcast_addr =	net_if_ipv6_maddr_add (iface, &mcast_addr.sin6_addr);
	
	if (if_mcast_addr == NULL) {
		LOG_ERR("Cannot join IPv6 multicast group");
		return false;
	}
	net_if_ipv6_maddr_join(if_mcast_addr);
	
	return true;
}

static void event_handler(struct net_mgmt_event_callback *cb,
			  uint32_t mgmt_event, struct net_if *iface)
{
	if ((mgmt_event & EVENT_MASK) != mgmt_event) {
		return;
	}

	if (mgmt_event == NET_EVENT_L4_CONNECTED) {
		LOG_INF("Network connected");

		connected = true;
		conf.ipv6.coap.mtu = net_if_get_mtu(iface);
		k_sem_give(&run_app);

		return;
	}

	if (mgmt_event == NET_EVENT_L4_DISCONNECTED) {
		LOG_INF("Network disconnected");

		connected = false;
		k_sem_reset(&run_app);

		return;
	}
}

static void init_app(void)
{
	LOG_INF(APP_BANNER);

#if defined(CONFIG_USERSPACE)
	struct k_mem_partition *parts[] = {
		&app_partition
	};

	int ret = k_mem_domain_init(&app_domain, ARRAY_SIZE(parts), parts);

	__ASSERT(ret == 0, "k_mem_domain_init() failed %d", ret);
	ARG_UNUSED(ret);
#endif

	if (IS_ENABLED(CONFIG_NET_CONNECTION_MANAGER)) {
		net_mgmt_init_event_callback(&mgmt_cb,
					     event_handler, EVENT_MASK);
		net_mgmt_add_event_callback(&mgmt_cb);

		net_conn_mgr_resend_status();
	}
}


static int start_client(void)
{
	int ret;

	// Wait for the connection. 
	k_sem_take(&run_app, K_FOREVER);

	LOG_INF("Starting...");

	ret = start_coap();
	if (ret < 0) {
		return ret;
	}

	ret = coap_find_server();
	if (ret == 0) {

		ret = coap_register_observers();

		while (connected && (ret == 0)) {
			ret = coap_process();
		}
	
	}

	LOG_INF("Stopping...");

	stop_coap();

	return ret;
}

void main(void)
{
	init_app();

	if (!IS_ENABLED(CONFIG_NET_CONNECTION_MANAGER)) {
		/* If the config library has not been configured to start the
		 * app only after we have a connection, then we can start
		 * it right away.
		 */
		k_sem_give(&run_app);
	}

	join_coap_multicast_group();

	hvac_init(TEMP_MIN, TEMP_MAX, TEMP_MIN_PRESENCE, TEMP_MAX_PRESENCE, HUMIDITY_MAX, AIQ_MAX);
	init_display();

#if defined(CONFIG_USERSPACE)
	k_thread_access_grant(k_current_get(), &run_app);
	k_mem_domain_add_thread(&app_domain, k_current_get());
	k_thread_user_mode_enter((k_thread_entry_t)start_client, NULL, NULL,
				 NULL);
#else

	exit(start_client());
#endif
}
```

## src/coap.c
```c
/* coap.c - UDP specific code for echo client */

/*
 * Copyright (c) 2017 Intel Corporation.
 * Copyright (c) 2018 Nordic Semiconductor ASA.
 *
 * SPDX-License-Identifier: Apache-2.0
 */

#include <zephyr/logging/log.h>
LOG_MODULE_REGISTER(coap, LOG_LEVEL_INF);

#include <zephyr/sys/byteorder.h>
#include <zephyr/zephyr.h>
#include <errno.h>
#include <stdio.h>
#include <stdlib.h>

#include <zephyr/net/socket.h>
#include <zephyr/net/net_mgmt.h>
#include <zephyr/net/net_ip.h>
#include <zephyr/net/udp.h>
#include <zephyr/net/coap.h>
#include <zephyr/net/socket.h>
#include <zephyr/net/tls_credentials.h>
#include <zephyr/random/rand32.h>

#include "common.h"
#include "net_private.h"

#define UDP_SLEEP K_MSEC(150)
#define UDP_WAIT K_SECONDS(10)
#define NUM_REPLIES 10

static const char * const echo_path[] = { "echo", NULL };
static const char * const temperature_path[] = {"sensors", "temperature", NULL };
static const char * const humidity_path[] = {"sensors",  "humidity", NULL };
static const char * const air_quality_path[] = {"sensors",  "air_quality", NULL };
static const char * const presence_path[] = {"sensors",  "presence", NULL };

// currently not used
// static const char * const air_pressure_path[] = {"sensors",  "air_pressure", NULL };
// static const char * const luminance_path[] = {"sensors",  "luminance", NULL };

static bool echo_received;
static struct coap_reply replies[NUM_REPLIES];
static int reply_acks[NUM_REPLIES];
static int reply_acks_wr_ptr;

//----------------------------------------------------------------
// Notification/Reply Callbacks
//----------------------------------------------------------------

static void send_obs_reply_ack(struct coap_packet *reply)
{
	struct coap_packet request;
	uint8_t *data;
	int r;

	data = (uint8_t *)k_malloc(MAX_COAP_MSG_LEN);
	if (!data) {
		return;
	}

	r = coap_ack_init(&request, reply, data, MAX_COAP_MSG_LEN, COAP_CODE_EMPTY);
	if (r < 0) {
		LOG_ERR("Failed to init CoAP message");
	}
	else
	{

		net_hexdump("ACK", request.data, request.offset);

		static struct sockaddr_in6 mcast_addr = {
							.sin6_family = AF_INET6,
							.sin6_addr = ALL_NODES_LOCAL_COAP_MCAST,
							.sin6_port = htons(COAP_PORT) };

		r = sendto(conf.ipv6.coap.sock, request.data, request.offset, 0, (struct sockaddr *) &mcast_addr, sizeof(mcast_addr));

		if (r < 0) {
			LOG_ERR("Failed to send CoAP ACK: %i", -r);
		}
	}

	k_free(data);
}

static int echo_request_cb(const struct coap_packet *response,
			       struct coap_reply *reply,
			       const struct sockaddr *from)
{
	
	echo_received = true;
	coap_reply_clear(reply);
	
	return 0;
}

static int notification_cb_temp(const struct coap_packet *response,
			       struct coap_reply *reply,
			       const struct sockaddr *from)
{
	const uint8_t *payload;
	uint16_t payload_len;

	payload = coap_packet_get_payload(response, &payload_len);
	if (payload == NULL) {
		LOG_ERR("NO PAYLOAD RECEIVED");
	}
	else
	{
		double result = atof(payload);
		LOG_DBG("Tempereature %lf", result);
		hvac_update_temperatur(result);
		display_update_temperatur(result);
	}

	return 0;
}

static int notification_cb_humidity(const struct coap_packet *response,
			       struct coap_reply *reply,
			       const struct sockaddr *from)
{
	const uint8_t *payload;
	uint16_t payload_len;

	payload = coap_packet_get_payload(response, &payload_len);
	if (payload == NULL) {
		LOG_ERR("NO PAYLOAD RECEIVED");
	}
	else
	{
		double result = atof(payload);
		LOG_DBG("Humidity %lf", result);
		hvac_update_humidity(result);
		display_update_humidity(result);
	}

	return 0;
}

static int notification_cb_air_quality(const struct coap_packet *response,
			       struct coap_reply *reply,
			       const struct sockaddr *from)
{
	const uint8_t *payload;
	uint16_t payload_len;

	payload = coap_packet_get_payload(response, &payload_len);
	if (payload == NULL) {
		LOG_ERR("NO PAYLOAD RECEIVED");
	}
	else
	{
		double result = atof(payload);
		LOG_DBG("Air Quality %lf", result);
		hvac_update_air_quality(result);
		display_update_air_quality(result);
	}
	
	return 0;
}

static int notification_cb_presence(const struct coap_packet *response,
			       struct coap_reply *reply,
			       const struct sockaddr *from)
{
	const uint8_t *payload;
	uint16_t payload_len;

	payload = coap_packet_get_payload(response, &payload_len);
	if (payload == NULL) {
		LOG_ERR("NO PAYLOAD RECEIVED");
	}
	else
	{
		// simple conversion between char and int
		int result = payload[0] == '0' ? 0 :1;
		LOG_DBG("Presence %i", result);
		hvac_update_pressence(result);
	}
	
	return 0;
}

//----------------------------------------------------------------
// CoAP Send and Receive Functions
//----------------------------------------------------------------,

static int coap_send_echo_request(struct config *cfg)
{
	uint8_t payload[] = "Hello World!\n";
	struct coap_packet request;
	const char * const *p;
	uint8_t *data;
	int r;

	data = (uint8_t *)k_malloc(MAX_COAP_MSG_LEN);
	if (!data) {
		return -ENOMEM;
	}

	r = coap_packet_init(&request, data, MAX_COAP_MSG_LEN,
			     COAP_VERSION_1, COAP_TYPE_CON,
			     COAP_TOKEN_MAX_LEN, coap_next_token(),
			     COAP_METHOD_PUT, coap_next_id());
	if (r < 0) {
		LOG_ERR("Failed to init CoAP message");
	}
	else
	{
		// Iterate over path
		for (p = echo_path; p && *p; p++) {
			r = coap_packet_append_option(&request, COAP_OPTION_URI_PATH,
							*p, strlen(*p));
			if (r < 0) {
				break;
			}
		}
		
		if (r < 0) {
			LOG_ERR("Unable add option to request");
		}
		else
		{
			r = coap_packet_append_payload_marker(&request);
			if (r < 0) {
				LOG_ERR("Unable to append payload marker");
			}
			else
			{
				r = coap_packet_append_payload(&request, (uint8_t *)payload,
									sizeof(payload) - 1);
				if (r < 0) {
					LOG_ERR("Not able to append payload");
				}
				else
				{
					net_hexdump("Request", request.data, request.offset);


					struct coap_reply *reply =coap_reply_next_unused((struct coap_reply *)&replies, sizeof(replies));
					coap_reply_init(reply, &request);
					reply->reply = echo_request_cb;

					static struct sockaddr_in6 mcast_addr = {
						.sin6_family = AF_INET6,
						.sin6_addr = ALL_NODES_LOCAL_COAP_MCAST,
						.sin6_port = htons(COAP_PORT) };

					r = sendto(cfg->coap.sock, request.data, request.offset, 0, (struct sockaddr *) &mcast_addr, sizeof(mcast_addr));
				}
			}
		}
	}

	k_free(data);

	return 0;
}


static int coap_send_observer_request(struct config *cfg, const char * const path[], coap_reply_t reply_cb)
{
	struct coap_packet request;
	const char * const *p;
	uint8_t *data;
	int r;

	data = (uint8_t *)k_malloc(MAX_COAP_MSG_LEN);
	if (!data) {
		return -ENOMEM;
	}

	r = coap_packet_init(&request, data, MAX_COAP_MSG_LEN,
			     COAP_VERSION_1, COAP_TYPE_CON,
			     COAP_TOKEN_MAX_LEN, coap_next_token(),
			     COAP_METHOD_GET, coap_next_id());
	if (r < 0) {
		LOG_ERR("Failed to init CoAP message");
	}
	else
	{
		r = coap_append_option_int(&request, COAP_OPTION_OBSERVE, 0);
		if (r < 0) {
			LOG_ERR("Failed to append Observe option");
		}
		else
		{
			// iterate over path and add to request
			for (p = path; p && *p; p++) {
				r = coap_packet_append_option(&request, COAP_OPTION_URI_PATH,
								*p, strlen(*p));
				if (r < 0) {
					LOG_ERR("Unable add option to request");
					break;
				}
			}
			if (r == 0) {
			
				if(reply_acks_wr_ptr < NUM_REPLIES)
				{
					net_hexdump("Request", request.data, request.offset);

					// Register a handler for the CoAP replies and notifications
					struct coap_reply *reply =coap_reply_next_unused((struct coap_reply *)&replies, sizeof(replies));
					coap_reply_init(reply, &request);
					reply->reply = reply_cb;
					reply_acks[reply_acks_wr_ptr] = -1;
					reply->user_data = &reply_acks[reply_acks_wr_ptr];
					reply_acks_wr_ptr++;

					static struct sockaddr_in6 mcast_addr = {
										.sin6_family = AF_INET6,
										.sin6_addr = ALL_NODES_LOCAL_COAP_MCAST,
										.sin6_port = htons(COAP_PORT) };

					r = sendto(cfg->coap.sock, request.data, request.offset, 0, (struct sockaddr *) &mcast_addr, sizeof(mcast_addr));
				}
			}
		}
	}
	
	k_free(data);

	return r;
}

int process_coap_reply(struct config *cfg, int flags)
{
	struct coap_packet reply;
	uint8_t *data;
	int rcvd;
	int ret;

	data = (uint8_t *)k_malloc(MAX_COAP_MSG_LEN);
	if (!data) {
		return -ENOMEM;
	}
	LOG_INF("Waiting for Reception");
	rcvd = recv(cfg->coap.sock, data, MAX_COAP_MSG_LEN, flags);
	if (rcvd == 0) {
		ret = -EIO;
	}
	else
	{
		if (rcvd < 0) {
			if (errno == EAGAIN || errno == EWOULDBLOCK) {
				ret = 0;
			} else {
				LOG_ERR("Error in Reception: %i", -rcvd);
				ret = -errno;
			}
		}
		else
		{
			net_hexdump("Response", data, rcvd);

			ret = coap_packet_parse(&reply, data, rcvd, NULL, 0);
			if (ret < 0) {
				LOG_ERR("Invalid data received");
			}else{
				(void) coap_response_received(&reply, NULL, (struct coap_reply *) &replies, sizeof(replies));
				uint8_t type = coap_header_get_type(&reply);

				if( type == COAP_TYPE_CON )
				{
					send_obs_reply_ack(&reply);
					
				}
			}
		}
	}
	k_free(data);

	return ret;
}


//----------------------------------------------------------------
// Setup, Teardown and runtime functions
//----------------------------------------------------------------

static int init_coap_proto(struct config *cfg, struct sockaddr *addr,
			   socklen_t addrlen)
{
	int ret;

	cfg->coap.sock = socket(addr->sa_family, SOCK_DGRAM, IPPROTO_UDP);

	if (cfg->coap.sock < 0) {
		LOG_ERR("Failed to create UDP socket (%s): %d", cfg->proto,
			errno);
		return -errno;
	}

	// Call bind instead of connect in order to setup a coap server in the future
	ret = bind(cfg->coap.sock, addr, addrlen);
	if (ret < 0) {
		LOG_ERR("Cannot connect to UDP remote (%s): %d", cfg->proto,
			errno);
		ret = -errno;
	}

	return ret;
}


int start_coap(void)
{
	int ret = 0;
	struct sockaddr_in6 addr6;

	if (IS_ENABLED(CONFIG_NET_IPV6)) {		
		(void)memset(&addr6, 0, sizeof(addr6));
		addr6.sin6_family = AF_INET6;
		addr6.sin6_port = htons(COAP_PORT);

		ret = init_coap_proto(&conf.ipv6, (struct sockaddr *)&addr6,
				      sizeof(addr6)); 
		if (ret < 0) {
			return ret;
		}
	}

	return ret;
}

int coap_find_server(void)
{
	int ret = 0;
	echo_received = false;
	while(ret == 0 && echo_received == false)
	{
		ret = coap_send_echo_request(&conf.ipv6);
		if (ret < 0) {
			return ret;
		}

		k_sleep(K_MSEC(5000));

		ret = process_coap_reply(&conf.ipv6, MSG_DONTWAIT);
		if (ret < 0) {
			return ret;
		}

	}
	return ret;
}

int coap_register_observers(void)
{
	int ret = 0;
	
	ret = coap_send_observer_request(&conf.ipv6, temperature_path, notification_cb_temp);
	if (ret < 0) {
		return ret;
	}

	ret = process_coap_reply(&conf.ipv6, 0);
	if (ret < 0) {
		LOG_ERR("process_coap_replD");
		return ret;
	}

	ret = coap_send_observer_request(&conf.ipv6, humidity_path, notification_cb_humidity);
	if (ret < 0) {
		return ret;
	}

	ret = process_coap_reply(&conf.ipv6, 0);
	if (ret < 0) {
		LOG_ERR("process_coap_replD");
		return ret;
	}

	ret = coap_send_observer_request(&conf.ipv6, air_quality_path, notification_cb_air_quality);
	if (ret < 0) {
		return ret;
	}

	ret = process_coap_reply(&conf.ipv6, 0);
	if (ret < 0) {
		LOG_ERR("process_coap_replD");
		return ret;
	}

	ret = coap_send_observer_request(&conf.ipv6, presence_path, notification_cb_presence);
	if (ret < 0) {
		return ret;
	}

	ret = process_coap_reply(&conf.ipv6, 0);
	if (ret < 0) {
		LOG_ERR("process_coap_replD");
		return ret;
	}

	return ret;
}

int coap_process(void)
{
	int ret = 0;

	ret = process_coap_reply(&conf.ipv6, 0);
	if (ret < 0) {
		LOG_ERR("process_coap_replD");
		return ret;
	}

	return ret;
}


void stop_coap(void)
{
	if (conf.ipv6.coap.sock >= 0) {
		(void)close(conf.ipv6.coap.sock);
	}
}
```

## src/common.h
```c
/*
 * Copyright (c) 2017 Intel Corporation.
 * Copyright (c) 2018 Nordic Semiconductor ASA.
 *
 * SPDX-License-Identifier: Apache-2.0
 */

/* Value of 0 will cause the IP stack to select next free port */
#define MY_PORT 0
#define STACK_SIZE 2048

#define COAP_PORT 5683
#define MAX_COAP_MSG_LEN 256
//4242

#if defined(CONFIG_USERSPACE)
#include <zephyr/app_memory/app_memdomain.h>
extern struct k_mem_partition app_partition;
extern struct k_mem_domain app_domain;
#define APP_BMEM K_APP_BMEM(app_partition)
#define APP_DMEM K_APP_DMEM(app_partition)
#else
#define APP_BMEM
#define APP_DMEM
#endif

#if IS_ENABLED(CONFIG_NET_TC_THREAD_PREEMPTIVE)
#define THREAD_PRIORITY K_PRIO_PREEMPT(8)
#else
#define THREAD_PRIORITY K_PRIO_COOP(CONFIG_NUM_COOP_PRIORITIES - 1)
#endif


struct config {
	const char *proto;

	struct {
		int sock;
		/* Work controlling coap data sending */
		char recv_buffer[MAX_COAP_MSG_LEN];
		struct k_work_delayable recv;
		struct k_work_delayable transmit;
		uint32_t expecting;
		uint32_t counter;
		uint32_t mtu;
	} coap;
};

struct configs {
	struct config ipv6;
};

#define ALL_NODES_LOCAL_COAP_MCAST { { { 0xff, 0x02, 0, 0, 0, 0, 0, 0, 0, 0, 0, 0, 0, 0, 0, 0xfd } } }
#define MY_IP6ADDR { { { 0x20, 0x01, 0x0d, 0xb8, 0, 0, 0, 0, 0, 0, 0, 0, 0, 0, 0, 0x2 } } }


#if !defined(CONFIG_NET_CONFIG_PEER_IPV4_ADDR)
#define CONFIG_NET_CONFIG_PEER_IPV4_ADDR ""
#endif

#if !defined(CONFIG_NET_CONFIG_PEER_IPV6_ADDR)
#define CONFIG_NET_CONFIG_PEER_IPV6_ADDR ""
#endif

extern char packet_buffer[];
extern int buffer_len;
extern struct configs conf;


void init_display(void);

int start_coap(void);
int coap_find_server(void);
int coap_register_observers(void);
int coap_process(void);
void stop_coap(void);

int hvac_init(double temp_min, double temp_max, double temp_min_presence, double temp_max_presence, double hum_max, int air_qual_max);
void hvac_update_temperatur(double temp);
void hvac_update_humidity(double hum);
void hvac_update_air_quality(int air_qual);
void hvac_update_pressence(int presence);

void display_update_temperatur(double temp);
void display_update_humidity(double hum);
void display_update_air_quality(int air_qual);
```

## src/display.c
```c
/*
 * Copyright (c) 2018 Jan Van Winkel <jan.van_winkel@dxplore.eu>
 *
 * SPDX-License-Identifier: Apache-2.0
 */

#include <zephyr/device.h>
#include <zephyr/drivers/display.h>
#include <lvgl.h>
#include <stdio.h>
#include <string.h>
#include <zephyr/zephyr.h>
#include <zephyr/drivers/sensor.h>

#include "common.h"

#include <logging/log.h>
LOG_MODULE_REGISTER(display, LOG_LEVEL_DBG);


void display_thread(void);

// Thread definitions to constantly update the display
K_THREAD_DEFINE(display_thread_id, STACK_SIZE,
		display_thread, NULL, NULL, NULL,
		THREAD_PRIORITY,
		IS_ENABLED(CONFIG_USERSPACE) ? K_USER : 0, -1);

static int aiq;
static double temperature, humidty;

void init_display(void)
{	
	const struct device *display_dev;
	lv_obj_t *text_label;

	display_dev = DEVICE_DT_GET(DT_CHOSEN(zephyr_display));
	if (!device_is_ready(display_dev)) {
		LOG_ERR("Device not ready, aborting test");
		return;
	}

	if (IS_ENABLED(CONFIG_LV_Z_POINTER_KSCAN)) {
		lv_obj_t *hello_world_button;

		hello_world_button = lv_btn_create(lv_scr_act());
		lv_obj_align(hello_world_button, LV_ALIGN_CENTER, 0, 0);
		text_label = lv_label_create(hello_world_button);
	} else {
		text_label = lv_label_create(lv_scr_act());
	}

	// Create Label on the left side with the text
	lv_label_set_text(text_label, "Thermostat\nT:\nH:\nAQI:");
	lv_obj_align(text_label, LV_ALIGN_TOP_LEFT, 0, 0);

	lv_task_handler();
	display_blanking_off(display_dev);

    #if defined(CONFIG_USERSPACE)
		k_mem_domain_add_thread(&app_domain, display_thread_id);	
		LOG_DBG("starting Thread");
    #endif

        k_thread_name_set(display_thread_id, "display-thread");
        k_thread_start(display_thread_id);
	
}


void display_thread(void)
{
    char data_str[50] = {0};

    struct sensor_value temp, hum;
	// Create label on the right side for the sensor data
	lv_obj_t *data_label = lv_label_create(lv_scr_act());
	lv_obj_align(data_label, LV_ALIGN_TOP_RIGHT, 0, 0);
    
    while (1) {
        // convert data to sensor value as a sprintf with a float or a double cuases a buffer overflwo
        sensor_value_from_double(&temp, temperature);
        sensor_value_from_double(&hum, humidty);
        
        snprintf(data_str, 50, "\n%d.%01d\n%d.%01d\n%d", temp.val1, temp.val2/10000 , hum.val1, hum.val2/10000, aiq);
        LOG_DBG("%s", data_str);
        lv_label_set_text(data_label, data_str);
		
		lv_task_handler();
		k_sleep(K_MSEC(10000));
	}
}

void display_update_temperatur(double temp)
{
    temperature = temp;
    k_wakeup(display_thread_id);
}

void display_update_humidity(double hum)
{
    humidty = hum;
    k_wakeup(display_thread_id);
}

void display_update_air_quality(int air_qual)
{
    aiq = air_qual;
    k_wakeup(display_thread_id);
}
```

## src/echo-client.c
```c
/* echo-client.c - Networking echo client */

/*
 * Copyright (c) 2017 Intel Corporation.
 * Copyright (c) 2018 Nordic Semiconductor ASA.
 *
 * SPDX-License-Identifier: Apache-2.0
 */

/*
 * The echo-client application is acting as a client that is run in Zephyr OS,
 * and echo-server is run in the host acting as a server. The client will send
 * either unicast or multicast packets to the server which will reply the packet
 * back to the originator.
 *
 * In this sample application we create four threads that start to send data.
 * This might not be what you want to do in your app so caveat emptor.
 */

#include <zephyr/logging/log.h>
LOG_MODULE_REGISTER(net_echo_client_sample, LOG_LEVEL_DBG);

#include <zephyr/zephyr.h>
#include <errno.h>
#include <stdio.h>
#include <stdlib.h>

#include <zephyr/net/socket.h>
#include <zephyr/net/tls_credentials.h>

#include <zephyr/net/net_mgmt.h>
#include <zephyr/net/net_event.h>
#include <zephyr/net/net_conn_mgr.h>

#if defined(CONFIG_USERSPACE)
#include <zephyr/app_memory/app_memdomain.h>
K_APPMEM_PARTITION_DEFINE(app_partition);
struct k_mem_domain app_domain;
#endif

#include "common.h"
#define APP_BANNER "Run echo client"

#define INVALID_SOCK (-1)

#define EVENT_MASK (NET_EVENT_L4_CONNECTED | \
		    NET_EVENT_L4_DISCONNECTED)

/* Generated by http://www.lipsum.com/
 * 2 paragraphs, 179 words, 1160 bytes of Lorem Ipsum
 */
char packet_buffer[] ="\0\0\0\0\0\0\0\0\0\0\0\0\0\0\0\0\0\0\0\0\0\0\0\0\0\0\0\0\0\0\0\0\0\0\0\0\0\0\0\0\0\0\0\0\0\0\0\0\0\0\0\0\0\0\0\0\0\0\0\0\0\0\0\0\0\0\0\0\0\0\0\0\0\0\0\0\0\0\0\0\0\0\0\0";
int buffer_len = sizeof(packet_buffer) - 1;

APP_DMEM struct configs conf = {
	.ipv6 = {
		.proto = "IPv6",
		.udp.sock = INVALID_SOCK,
	},
};

static APP_BMEM struct pollfd fd;

static APP_BMEM bool connected;
K_SEM_DEFINE(run_app, 0, 1);

static struct net_mgmt_event_callback mgmt_cb;

static void wait(void)
{
	/* Wait for event on any socket used. Once event occurs,
	 * we'll check them all.
	 */
	if (poll(&fd, 1, -1) < 0) {
		LOG_ERR("Error in poll:%d", errno);
	}
}

static int start_udp_and_tcp(void)
{
	int ret;

	LOG_INF("Starting...");

	if (IS_ENABLED(CONFIG_NET_UDP)) {
		ret = start_udp();
		if (ret < 0) {
			return ret;
		}
	}

	if (conf.ipv6.udp.sock >= 0) {
		fd.fd = conf.ipv6.udp.sock;
		fd.events = POLLIN;
	}

	return 0;
}

int send_sensor_values(void)
{
	int ret;

	wait();
	/*	
	int lux_value = get_lux_value(0);
	int pir_value = get_pir_value(0);
	bme680_sensor_data_t sensor_data;
	bme680_get_sensor_data(&sensor_data);
	if (lux_value > 0) {
		wait();
		// TODO adjust to your packet structure/serializing logic
		//memcpy(packet_buffer, &lux_value, sizeof(lux_value)); 
		//buffer_len = sizeof(lux_value) - 1;
		sprintf((char*)&packet_buffer, "lux:%i;pir:%i;T:%d.%.2i;P:%d.%.2i;H:%d.%.2i;G:%d.%.2i\n",
				lux_value, pir_value,
				sensor_data.temp.val1, sensor_data.temp.val2, 
				sensor_data.press.val1, sensor_data.press.val2,
				sensor_data.humidity.val1, sensor_data.humidity.val2, 
				sensor_data.gas_res.val1, sensor_data.gas_res.val2);
		//buffer_len = strlen((char*)&packet_buffer);
		NET_INFO("Sending: %s\n", packet_buffer);
		//LOG_DBG("Set %d bytes, value %d", sizeof(lux_value), * (int *) &packet_buffer[0]);
		ret = process_udp();
	//}
	//
	//if (IS_ENABLED(CONFIG_NET_UDP)) {
	//	wait();
	//	ret = process_udp();
	*/
	sprintf((char*)&packet_buffer, "Hello World\n");
	ret = process_udp();
		if (ret < 0) {
			return ret;
		}
	//}

	return 0;
}

static void stop_udp_and_tcp(void)
{
	LOG_INF("Stopping...");

	if (IS_ENABLED(CONFIG_NET_UDP)) {
		stop_udp();
	}
}

static void event_handler(struct net_mgmt_event_callback *cb,
			  uint32_t mgmt_event, struct net_if *iface)
{
	if ((mgmt_event & EVENT_MASK) != mgmt_event) {
		return;
	}

	if (mgmt_event == NET_EVENT_L4_CONNECTED) {
		LOG_INF("Network connected");

		connected = true;
		conf.ipv6.udp.mtu = net_if_get_mtu(iface);
		k_sem_give(&run_app);

		return;
	}

	if (mgmt_event == NET_EVENT_L4_DISCONNECTED) {
		LOG_INF("Network disconnected");

		connected = false;
		k_sem_reset(&run_app);

		return;
	}
}

static void init_app(void)
{
	LOG_INF(APP_BANNER);

#if defined(CONFIG_USERSPACE)
	struct k_mem_partition *parts[] = {
		&app_partition
	};

	int ret = k_mem_domain_init(&app_domain, ARRAY_SIZE(parts), parts);

	__ASSERT(ret == 0, "k_mem_domain_init() failed %d", ret);
	ARG_UNUSED(ret);
#endif

	if (IS_ENABLED(CONFIG_NET_CONNECTION_MANAGER)) {
		net_mgmt_init_event_callback(&mgmt_cb,
					     event_handler, EVENT_MASK);
		net_mgmt_add_event_callback(&mgmt_cb);

		net_conn_mgr_resend_status();
	}
}

static int start_client(void)
{
	int iterations = 1;
	int i = 0;
	int ret;

	while (iterations == 0 || i < iterations) {
		/* Wait for the connection. */
		k_sem_take(&run_app, K_FOREVER);

		ret = start_udp_and_tcp();

		if(ret == 0)
		{
			do
			{
				/* code */
				ret =	pir_init();

				k_sleep(K_MSEC(1000));
			} while (ret != 0);
		
		}

		while (connected && (ret == 0)) {
			ret = send_sensor_values();
			k_sleep(K_MSEC(5000));
		}

		stop_udp_and_tcp();
	}

	return ret;
}

void main(void)
{
	init_app();

	if (!IS_ENABLED(CONFIG_NET_CONNECTION_MANAGER)) {
		/* If the config library has not been configured to start the
		 * app only after we have a connection, then we can start
		 * it right away.
		 */
		k_sem_give(&run_app);
	}

	k_thread_priority_set(k_current_get(), THREAD_PRIORITY);

#if defined(CONFIG_USERSPACE)
	k_thread_access_grant(k_current_get(), &run_app);
	k_mem_domain_add_thread(&app_domain, k_current_get());

	k_thread_user_mode_enter((k_thread_entry_t)start_client, NULL, NULL,
				 NULL);
#else
	exit(start_client());
#endif
}
```

## src/hvac.c
```c
/*
 * Copyright (c) 2016 Open-RnD Sp. z o.o.
 * Copyright (c) 2020 Nordic Semiconductor ASA
 *
 * SPDX-License-Identifier: Apache-2.0
 */

#include <zephyr/zephyr.h>
#include <zephyr/device.h>
#include <zephyr/drivers/gpio.h>
#include <zephyr/drivers/sensor.h>
#include <zephyr/drivers/adc.h>

#include <zephyr/sys/util.h>
#include <zephyr/sys/printk.h>
#include <inttypes.h>

#include <stdio.h>
#include "common.h"

#include <logging/log.h>
LOG_MODULE_REGISTER(hvac, LOG_LEVEL_DBG);

//--------------------------------------------------------
// Alias definitions 
//--------------------------------------------------------

#define HEATING_NODE	DT_ALIAS(led0)
#if !DT_NODE_HAS_STATUS(HEATING_NODE, okay)
#error "Unsupported board: led0 devicetree alias is not defined"
#endif
static const struct gpio_dt_spec heating_out = GPIO_DT_SPEC_GET_OR(HEATING_NODE, gpios, {0});

#define COOLING_NODE	DT_ALIAS(led1)
#if !DT_NODE_HAS_STATUS(COOLING_NODE, okay)
#error "Unsupported board: led0 devicetree alias is not defined"
#endif
static const struct gpio_dt_spec cooling_out = GPIO_DT_SPEC_GET_OR(COOLING_NODE, gpios, {0});

#define VENTING_NODE	DT_ALIAS(led2)
#if !DT_NODE_HAS_STATUS(VENTING_NODE, okay)
#error "Unsupported board: led0 devicetree alias is not defined"
#endif
static const struct gpio_dt_spec venting_out = GPIO_DT_SPEC_GET_OR(VENTING_NODE, gpios, {0});



//--------------------------------------------------------
// Static helper functions 
//--------------------------------------------------------

int outputs_init(void);
void hvac_thread(void);

//--------------------------------------------------------
// Runtime Variables 
//--------------------------------------------------------

static double temperature_min;
static double temperature_max;
static double temperature_min_presence;
static double temperature_max_presence;
static double humidity_max;
static int air_quality_max;

static int presence;
static double temperature;
static double humidity;
static int air_quality;


// Thread definitions to update the outputs an mimic a HVAC
K_THREAD_DEFINE(hvac_thread_id, STACK_SIZE,
		hvac_thread, NULL, NULL, NULL,
		THREAD_PRIORITY,
		IS_ENABLED(CONFIG_USERSPACE) ? K_USER : 0, -1);

int hvac_init(double temp_min, double temp_max, 
				double temp_min_presence, double temp_max_presence, 
				double hum_max, int air_qual_max)
{
	int ret = outputs_init();
	if(ret < 0)
	{
		return ret;
	}

	temperature_min = temp_min;
	temperature_max = temp_max;
	temperature_min_presence = temp_min_presence;
	temperature_max_presence = temp_max_presence;
	humidity_max = hum_max;
	air_quality_max = air_qual_max;

#if defined(CONFIG_USERSPACE)
		k_mem_domain_add_thread(&app_domain, hvac_thread_id);	
		LOG_DBG("starting Thread");
#endif

	k_thread_name_set(hvac_thread_id, "hvac-thread");
	k_thread_start(hvac_thread_id);

	return 0;
}

void hvac_thread(void)
{
	int heating_state = 0;
	int cooling_state = 0;
	int venting_state = 0;

	while(true)
	{
		if(presence == 0)
		{
			if(temperature > temperature_max)
			{
				gpio_pin_set(heating_out.port, heating_out.pin, 0);
				gpio_pin_set(cooling_out.port, cooling_out.pin, 1);
				if(cooling_state == 0)
				{
					LOG_INF("Enabling Cooling");
				}
				heating_state = 0;
				cooling_state = 1;
			}
			else if (temperature < temperature_min)
			{
				gpio_pin_set(heating_out.port, heating_out.pin, 1);
				gpio_pin_set(cooling_out.port, cooling_out.pin, 0);
				if(heating_state == 0)
				{
					LOG_INF("Enabling Heating");
				}
				heating_state = 1;
				cooling_state = 0;
			} 
			else
			{
				gpio_pin_set(heating_out.port, heating_out.pin, 0);
				gpio_pin_set(cooling_out.port, cooling_out.pin, 0);
				if(cooling_state == 1)
				{
					LOG_INF("Disabling Cooling");
				}
				else if(heating_state == 1)
				{
					LOG_INF("Disabling Heating");
				}

				heating_state = 0;
				cooling_state = 0;
			}
		}
		else
		{
			if(temperature > temperature_max_presence)
			{
				gpio_pin_set(heating_out.port, heating_out.pin, 0);
				gpio_pin_set(cooling_out.port, cooling_out.pin, 1);
				if(cooling_state == 0)
				{
					LOG_INF("Enabling Cooling");
				}

				heating_state = 0;
				cooling_state = 1;
			}
			else if (temperature < temperature_min_presence)
			{
				gpio_pin_set(heating_out.port, heating_out.pin, 1);
				gpio_pin_set(cooling_out.port, cooling_out.pin, 0);
				if(heating_state == 0)
				{
					LOG_INF("Enabling Heating");
				}
				heating_state = 1;
				cooling_state = 0;
			} 
			else
			{
				gpio_pin_set(heating_out.port, heating_out.pin, 0);
				gpio_pin_set(cooling_out.port, cooling_out.pin, 0);
				if(cooling_state == 1)
				{
					LOG_INF("Disabling Cooling");
				}
				else if(heating_state == 1)
				{
					LOG_INF("Disabling Heating");
				}
				heating_state = 0;
				cooling_state = 0;
			}
		}

		if(air_quality > air_quality_max || humidity > humidity_max)
		{
			gpio_pin_set(venting_out.port, venting_out.pin, 1);
			if(venting_state == 0)
			{
				LOG_INF("Enabling Venting");
			}
			venting_state =1;
		}
		else
		{
			gpio_pin_set(venting_out.port, venting_out.pin, 0);
			if(venting_state == 1)
			{
				LOG_INF("Disabling Venting");
			}
			venting_state =0;
		}
		

		gpio_pin_set(heating_out.port, heating_out.pin, heating_state);
		gpio_pin_set(cooling_out.port, cooling_out.pin, cooling_state);
		gpio_pin_set(venting_out.port, venting_out.pin, venting_state);

		LOG_DBG("Current State: heating_state %d cooling_state %d venting_state %d", heating_state, cooling_state, venting_state);
		LOG_DBG("temperature_min %lf, temperature %lf, temperature_max %lf", temperature_min, temperature, temperature_max);
		LOG_DBG("temperature_min_presence %lf, temperature %lf,  temperature_max_presence %lf", temperature_min_presence, temperature, temperature_max_presence);
		LOG_DBG("air_quality %d, air_quality_max %d, humidity %lf, humidity_max %lf", air_quality, air_quality_max, humidity, humidity_max);
		k_sleep(K_MSEC(5000));
	}
}

void hvac_update_temperatur(double temp)
{
    temperature = temp;
	LOG_DBG("New temperature value: %lf", temp);
}

void hvac_update_humidity(double hum)
{
    humidity = hum;
	LOG_DBG("New humidity value: %lf", hum);
}

void hvac_update_air_quality(int air_qual)
{
    air_quality = air_qual;
	LOG_DBG("New air quality value: %d", air_qual);
}

void hvac_update_pressence(int pres)
{
    presence = pres;
	LOG_DBG("New pressence value: %d", pres);
}


int outputs_init(void)
{
    
	int ret=device_is_ready(heating_out.port);

	if (!ret) {
		LOG_ERR("Error: heating_out device %s is not ready\n",
		       heating_out.port->name);
		return ret;
	}

	ret = gpio_pin_configure_dt(&heating_out, GPIO_OUTPUT_INACTIVE);
	if (ret != 0) {
		LOG_ERR("Error %d: failed to configure %s pin %d\n",
		       ret, heating_out.port->name, heating_out.pin);
		return ret;
	}

	ret=device_is_ready(venting_out.port);

	if (!ret) {
		LOG_ERR("Error: venting_out device %s is not ready\n",
		       venting_out.port->name);
		return ret;
	}

	ret = gpio_pin_configure_dt(&venting_out, GPIO_OUTPUT_INACTIVE);
	if (ret != 0) {
		LOG_ERR("Error %d: failed to configure %s pin %d\n",
		       ret, venting_out.port->name, venting_out.pin);
		return ret;
	}

	ret=device_is_ready(cooling_out.port);

	if (!ret) {
		LOG_ERR("Error: cooling_out device %s is not ready\n",
		       cooling_out.port->name);
		return ret;
	}

	ret = gpio_pin_configure_dt(&cooling_out, GPIO_OUTPUT_INACTIVE);
	if (ret != 0) {
		LOG_ERR("Error %d: failed to configure %s pin %d\n",
		       ret, cooling_out.port->name, cooling_out.pin);
		return ret;
	}

	return 0;
}
```

## src/thermostat.c
```c
/* echo-client.c - Networking echo client */

/*
 * Copyright (c) 2017 Intel Corporation.
 * Copyright (c) 2018 Nordic Semiconductor ASA.
 *
 * SPDX-License-Identifier: Apache-2.0
 */

/*
 * The echo-client application is acting as a client that is run in Zephyr OS,
 * and echo-server is run in the host acting as a server. The client will send
 * either unicast or multicast packets to the server which will reply the packet
 * back to the originator.
 *
 * In this sample application we create four threads that start to send data.
 * This might not be what you want to do in your app so caveat emptor.
 */

#include <zephyr/logging/log.h>
LOG_MODULE_REGISTER(thermostat, LOG_LEVEL_INF);

#include <zephyr/zephyr.h>
#include <errno.h>
#include <stdio.h>
#include <stdlib.h>

#include <zephyr/net/socket.h>
#include <zephyr/net/tls_credentials.h>

#include <zephyr/net/net_mgmt.h>
#include <zephyr/net/net_event.h>
#include <zephyr/net/net_conn_mgr.h>


#ifndef TEMP_MIN
	#define TEMP_MIN 24.0
#endif

#ifndef TEMP_MAX
	#define TEMP_MAX 28.0
#endif

#ifndef TEMP_MIN_PRESENCE
	#define TEMP_MIN_PRESENCE 25.0
#endif

#ifndef TEMP_MAX_PRESENCE
	#define TEMP_MAX_PRESENCE 27.0
#endif

#ifndef HUMIDITY_MAX
	#define HUMIDITY_MAX 75.0
#endif

#ifndef AIQ_MAX
	#define AIQ_MAX 100
#endif

#if defined(CONFIG_USERSPACE)
#include <zephyr/app_memory/app_memdomain.h>
K_APPMEM_PARTITION_DEFINE(app_partition);
struct k_mem_domain app_domain;
#endif

#include "common.h"
#define APP_BANNER "Run echo client"

#define INVALID_SOCK (-1)

#define EVENT_MASK (NET_EVENT_L4_CONNECTED | \
		    NET_EVENT_L4_DISCONNECTED)

/* Generated by http://www.lipsum.com/
 * 2 paragraphs, 179 words, 1160 bytes of Lorem Ipsum
 */
char packet_buffer[] ="\0\0\0\0\0\0\0\0\0\0\0\0\0\0\0\0\0\0\0\0\0\0\0\0\0\0\0\0\0\0\0\0\0\0\0\0\0\0\0\0\0\0\0\0\0\0\0\0\0\0\0\0\0\0\0\0\0\0\0\0\0\0\0\0\0\0\0\0\0\0\0\0\0\0\0\0\0\0\0\0\0\0\0\0";
int buffer_len = sizeof(packet_buffer) - 1;

APP_DMEM struct configs conf = {
	.ipv6 = {
		.proto = "IPv6",
		.coap.sock = INVALID_SOCK,
	},
};

static APP_BMEM bool connected;
K_SEM_DEFINE(run_app, 0, 1);

static struct net_mgmt_event_callback mgmt_cb;

static bool join_coap_multicast_group(void)
{
	static struct in6_addr my_addr = MY_IP6ADDR;
	static struct sockaddr_in6 mcast_addr = {
		.sin6_family = AF_INET6,
		.sin6_addr = ALL_NODES_LOCAL_COAP_MCAST,
		.sin6_port = htons(COAP_PORT) };
	struct net_if_addr *ifaddr;
	struct net_if *iface;

	iface = net_if_get_default();
	if (!iface) {
		LOG_ERR("Could not get te default interface\n");
		return false;
	}

#if defined(CONFIG_NET_CONFIG_SETTINGS)
	if (net_addr_pton(AF_INET6,
			  CONFIG_NET_CONFIG_MY_IPV6_ADDR,
			  &my_addr) < 0) {
		LOG_ERR("Invalid IPv6 address %s",
			CONFIG_NET_CONFIG_MY_IPV6_ADDR);
	}
#endif

	ifaddr = net_if_ipv6_addr_add(iface, &my_addr, NET_ADDR_MANUAL, 0);
	if (!ifaddr) {
		LOG_ERR("Could not add unicast address to interface");
		return false;
	}

	ifaddr->addr_state = NET_ADDR_PREFERRED;

	struct net_if_mcast_addr *if_mcast_addr =	net_if_ipv6_maddr_add (iface, &mcast_addr.sin6_addr);
	
	if (if_mcast_addr == NULL) {
		LOG_ERR("Cannot join IPv6 multicast group");
		return false;
	}
	net_if_ipv6_maddr_join(if_mcast_addr);
	
	return true;
}

static void event_handler(struct net_mgmt_event_callback *cb,
			  uint32_t mgmt_event, struct net_if *iface)
{
	if ((mgmt_event & EVENT_MASK) != mgmt_event) {
		return;
	}

	if (mgmt_event == NET_EVENT_L4_CONNECTED) {
		LOG_INF("Network connected");

		connected = true;
		conf.ipv6.coap.mtu = net_if_get_mtu(iface);
		k_sem_give(&run_app);

		return;
	}

	if (mgmt_event == NET_EVENT_L4_DISCONNECTED) {
		LOG_INF("Network disconnected");

		connected = false;
		k_sem_reset(&run_app);

		return;
	}
}

static void init_app(void)
{
	LOG_INF(APP_BANNER);

#if defined(CONFIG_USERSPACE)
	struct k_mem_partition *parts[] = {
		&app_partition
	};

	int ret = k_mem_domain_init(&app_domain, ARRAY_SIZE(parts), parts);

	__ASSERT(ret == 0, "k_mem_domain_init() failed %d", ret);
	ARG_UNUSED(ret);
#endif

	if (IS_ENABLED(CONFIG_NET_CONNECTION_MANAGER)) {
		net_mgmt_init_event_callback(&mgmt_cb,
					     event_handler, EVENT_MASK);
		net_mgmt_add_event_callback(&mgmt_cb);

		net_conn_mgr_resend_status();
	}
}


static int start_client(void)
{
	int ret;

	/* Wait for the connection. */
	k_sem_take(&run_app, K_FOREVER);

	LOG_INF("Starting...");

	ret = start_coap();
	if (ret < 0) {
		return ret;
	}

	ret = coap_find_server();
	if (ret == 0) {

		ret = coap_register_observers();

		while (connected && (ret == 0)) {
			ret = coap_process();
		}
	
	}

	LOG_INF("Stopping...");

	stop_coap();

	return ret;
}

void main(void)
{
	init_app();

	if (!IS_ENABLED(CONFIG_NET_CONNECTION_MANAGER)) {
		/* If the config library has not been configured to start the
		 * app only after we have a connection, then we can start
		 * it right away.
		 */
		k_sem_give(&run_app);
	}

	join_coap_multicast_group();

	hvac_init(TEMP_MIN, TEMP_MAX, TEMP_MIN_PRESENCE, TEMP_MAX_PRESENCE, HUMIDITY_MAX, AIQ_MAX);
	init_display();

#if defined(CONFIG_USERSPACE)
	k_thread_access_grant(k_current_get(), &run_app);
	k_mem_domain_add_thread(&app_domain, k_current_get());
	k_thread_user_mode_enter((k_thread_entry_t)start_client, NULL, NULL,
				 NULL);
#else

	exit(start_client());
#endif
}
```
