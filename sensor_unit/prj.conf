## CMakeLists.txt
```
# SPDX-License-Identifier: Apache-2.0

cmake_minimum_required(VERSION 3.20.0)

find_package(Zephyr REQUIRED HINTS $ENV{ZEPHYR_BASE})
project(sockets_echo_server)

target_sources( app PRIVATE src/main.c)
target_sources( app PRIVATE src/sensors.c)
target_sources( app PRIVATE src/coap.c)
include(${ZEPHYR_BASE}/samples/net/common/common.cmake)


target_include_directories(app PRIVATE ${ZEPHYR_BASE}/subsys/net/ip)
```

## prj.conf
```kconfig
# Generic options
CONFIG_FPU=y

# Generic networking options
CONFIG_NETWORKING=y
CONFIG_NET_UDP=y
CONFIG_NET_TCP=y
CONFIG_NET_IPV6=y
CONFIG_NET_IPV4=y
CONFIG_NET_SOCKETS=y
CONFIG_NET_SOCKETS_POSIX_NAMES=y
CONFIG_POSIX_MAX_FDS=6
CONFIG_NET_CONNECTION_MANAGER=y

# Kernel options
CONFIG_MAIN_STACK_SIZE=2048
CONFIG_HEAP_MEM_POOL_SIZE=5120
CONFIG_ENTROPY_GENERATOR=y
CONFIG_TEST_RANDOM_GENERATOR=y
CONFIG_INIT_STACKS=y

# Logging
CONFIG_NET_LOG=y
CONFIG_LOG=y
CONFIG_NET_STATISTICS=y
CONFIG_PRINTK=y

# Network buffers
CONFIG_NET_PKT_RX_COUNT=16
CONFIG_NET_PKT_TX_COUNT=16
CONFIG_NET_BUF_RX_COUNT=64
CONFIG_NET_BUF_TX_COUNT=64
CONFIG_NET_CONTEXT_NET_PKT_POOL=y

# IP address options
CONFIG_NET_IF_UNICAST_IPV6_ADDR_COUNT=3
CONFIG_NET_IF_MCAST_IPV6_ADDR_COUNT=10
CONFIG_NET_MAX_CONTEXTS=10

# Network shell
CONFIG_NET_SHELL=y
CONFIG_SHELL=y

# Network application options and configuration
CONFIG_NET_CONFIG_SETTINGS=y
CONFIG_NET_CONFIG_NEED_IPV6=y
CONFIG_NET_CONFIG_MY_IPV6_ADDR="2001:db8::1"
CONFIG_NET_CONFIG_PEER_IPV6_ADDR="2001:db8::2"

# Number of socket descriptors might need adjusting
# if there are more than 1 handlers defined.
CONFIG_POSIX_MAX_FDS=12

CONFIG_COAP=y
CONFIG_COAP_LOG_LEVEL_DBG=y

# Sensors
CONFIG_SENSOR=y
CONFIG_ADC=y
CONFIG_GPIO=y
CONFIG_I2C=y
CONFIG_BME680=y
```

## overlay-ot.conf
```kconfig
CONFIG_NEWLIB_LIBC=y

# Disable TCP and IPv4 (TCP disabled to avoid heavy traffic)
CONFIG_NET_TCP=n
CONFIG_NET_IPV4=n

CONFIG_NET_IPV6_NBR_CACHE=n
CONFIG_NET_IPV6_MLD=n
CONFIG_NET_CONFIG_NEED_IPV4=n
CONFIG_NET_CONFIG_MY_IPV4_ADDR=""
CONFIG_NET_CONFIG_PEER_IPV4_ADDR=""

CONFIG_SYSTEM_WORKQUEUE_STACK_SIZE=2048

# Enable OpenThread shell
CONFIG_SHELL=y
CONFIG_OPENTHREAD_SHELL=y
CONFIG_SHELL_STACK_SIZE=3072

CONFIG_NET_L2_OPENTHREAD=y

CONFIG_OPENTHREAD_DEBUG=y
CONFIG_OPENTHREAD_L2_DEBUG=y
CONFIG_OPENTHREAD_L2_LOG_LEVEL_INF=y

CONFIG_OPENTHREAD_CHANNEL=26
CONFIG_OPENTHREAD_NETWORKKEY="00:11:22:33:44:55:66:77:88:99:aa:bb:cc:dd:ee:ff"

CONFIG_NET_CONFIG_MY_IPV6_ADDR="fdde:ad00:beef::2"
CONFIG_NET_CONFIG_PEER_IPV6_ADDR="fdde:ad00:beef::1"

# mbedTLS tweaks
CONFIG_MBEDTLS_SSL_MAX_CONTENT_LEN=768
```

## src/main.c
```c
/* echo-server.c - Networking echo server */

/*
 * Copyright (c) 2016 Intel Corporation.
 * Copyright (c) 2018 Nordic Semiconductor ASA.
 *
 * SPDX-License-Identifier: Apache-2.0
 */

#include <zephyr/logging/log.h>
LOG_MODULE_REGISTER(sensor_unit, LOG_LEVEL_INF);

#include <zephyr/zephyr.h>
#include <zephyr/linker/sections.h>
#include <errno.h>
#include <zephyr/shell/shell.h>

#include <zephyr/net/net_core.h>
#include <zephyr/net/tls_credentials.h>

#include <zephyr/net/net_mgmt.h>
#include <zephyr/net/net_event.h>
#include <zephyr/net/net_conn_mgr.h>

#include <zephyr/net/socket.h>
#include <zephyr/net/net_mgmt.h>
#include <zephyr/net/net_ip.h>
#include <zephyr/net/udp.h>
#include <zephyr/net/coap.h>
#include <zephyr/net/coap_link_format.h>


#include "common.h"
#include "net_private.h"
#include "ipv6.h"

#define APP_BANNER "sensor unit"


static struct k_sem quit_lock;
static struct net_mgmt_event_callback mgmt_cb;
static bool connected;
K_SEM_DEFINE(run_app, 0, 1);
static bool want_to_quit;

#if defined(CONFIG_USERSPACE)
K_APPMEM_PARTITION_DEFINE(app_partition);
struct k_mem_domain app_domain;
#endif

#define EVENT_MASK (NET_EVENT_L4_CONNECTED | \
		    NET_EVENT_L4_DISCONNECTED)

APP_DMEM struct configs conf = {
	.ipv6 = {
		.proto = "IPv6",
	},
};

void quit(void)
{
	k_sem_give(&quit_lock);
}

static void event_handler(struct net_mgmt_event_callback *cb,
			  uint32_t mgmt_event, struct net_if *iface)
{
	if ((mgmt_event & EVENT_MASK) != mgmt_event) {
		return;
	}

	if (want_to_quit) {
		k_sem_give(&run_app);
		want_to_quit = false;
	}

	if (mgmt_event == NET_EVENT_L4_CONNECTED) {
		LOG_INF("Network connected");

		connected = true;
		k_sem_give(&run_app);

		return;
	}

	if (mgmt_event == NET_EVENT_L4_DISCONNECTED) {
		if (connected == false) {
			LOG_INF("Waiting network to be connected");
		} else {
			LOG_INF("Network disconnected");
			connected = false;
		}

		k_sem_reset(&run_app);

		return;
	}
}

static void init_app(void)
{
#if defined(CONFIG_USERSPACE)
	struct k_mem_partition *parts[] = {
#if Z_LIBC_PARTITION_EXISTS
		&z_libc_partition,
#endif
		&app_partition
	};

	int ret = k_mem_domain_init(&app_domain, ARRAY_SIZE(parts), parts);

	__ASSERT(ret == 0, "k_mem_domain_init() failed %d", ret);
	ARG_UNUSED(ret);
#endif

	k_sem_init(&quit_lock, 0, K_SEM_MAX_LIMIT);

	LOG_INF(APP_BANNER);

	if (IS_ENABLED(CONFIG_NET_CONNECTION_MANAGER)) {
		net_mgmt_init_event_callback(&mgmt_cb,
					     event_handler, EVENT_MASK);
		net_mgmt_add_event_callback(&mgmt_cb);

		net_conn_mgr_resend_status();
	}
}

static int cmd_sample_quit(const struct shell *shell,
			  size_t argc, char *argv[])
{
	want_to_quit = true;

	net_conn_mgr_resend_status();

	quit();

	return 0;
}

SHELL_STATIC_SUBCMD_SET_CREATE(sample_commands,
	SHELL_CMD(quit, NULL,
		  "Quit the sample application\n",
		  cmd_sample_quit),
	SHELL_SUBCMD_SET_END
);

SHELL_CMD_REGISTER(sample, &sample_commands,
		   "Sample application commands", NULL);

void main(void)
{
	init_app();

	if (!IS_ENABLED(CONFIG_NET_CONNECTION_MANAGER)) {
		/* If the config library has not been configured to start the
		 * app only after we have a connection, then we can start
		 * it right away.
		 */
		k_sem_give(&run_app);
	}
	
	sensors_init();
	
	/* Wait for the connection. */
	k_sem_take(&run_app, K_FOREVER);

	LOG_INF("Starting...");

	start_coap();
	
	k_sem_take(&quit_lock, K_FOREVER);

	if (connected) {
		LOG_INF("Stopping...");
		if (IS_ENABLED(CONFIG_NET_UDP)) {
			stop_coap();
		}
	}
}
```

## src/common.h
```c
/*
 * Copyright (c) 2017-2019 Intel Corporation.
 * Copyright (c) 2018 Nordic Semiconductor ASA.
 *
 * SPDX-License-Identifier: Apache-2.0
 */


#include <zephyr/drivers/sensor.h>


#define COAP_PORT 5683
#define STACK_SIZE 2048

#define MAX_COAP_MSG_LEN 256
#define MAX_RETRANSMIT_COUNT 4

#define THREAD_PRIORITY K_PRIO_PREEMPT(8)

#define STATS_TIMER 60 /* How often to print statistics (in seconds) */

#define ALL_NODES_LOCAL_COAP_MCAST \
	{ { { 0xff, 0x02, 0, 0, 0, 0, 0, 0, 0, 0, 0, 0, 0, 0, 0, 0xfd } } }

#define MY_IP6ADDR \
	{ { { 0x20, 0x01, 0x0d, 0xb8, 0, 0, 0, 0, 0, 0, 0, 0, 0, 0, 0, 0x1 } } }

#define COAP_RESOURCE_ECHO 1
#define COAP_RESOURCE_TEMPERATURE 2
#define COAP_RESOURCE_HUMIDITY 3
#define COAP_RESOURCE_AIR_QUALITY 4
#define COAP_RESOURCE_AIR_PRESSURE 5
#define COAP_RESOURCE_PRESSENCE 6
#define COAP_RESOURCE_LUMINANCE 7
#define LAST_ID_RESOURCE_ID COAP_RESOURCE_LUMINANCE

#if defined(CONFIG_USERSPACE)
#include <zephyr/app_memory/app_memdomain.h>
extern struct k_mem_partition apption;
extern struct k_mem_domain app_domain;
#define APP_BMEM K_APP_BMEM(app_partition)
#define APP_DMEM K_APP_DMEM(app_partition)
#else
#define APP_BMEM
#define APP_DMEM
#endif

struct config {
	const char *proto;

	struct {
		int sock;
		char recv_buffer[MAX_COAP_MSG_LEN];
		uint32_t counter;
		atomic_t bytes_received;
	} coap;
};

struct configs {
	struct config ipv6;
};

extern struct configs conf;

typedef struct 
{
	int presence;
	int luminance;
	struct sensor_value temp;
	struct sensor_value press;
	struct sensor_value humidity;
	int air_quality_index;
} sensor_data_t;

void start_coap(void);
void coap_resource_update(int resource_id);
void stop_coap(void);

void get_sensor_data(sensor_data_t *sensor_data);
int sensors_init(void);

void quit(void);
```

## src/echo-client.c
```c
/* echo-client.c - Networking echo client */

/*
 * Copyright (c) 2017 Intel Corporation.
 * Copyright (c) 2018 Nordic Semiconductor ASA.
 *
 * SPDX-License-Identifier: Apache-2.0
 */

/*
 * The echo-client application is acting as a client that is run in Zephyr OS,
 * and echo-server is run in the host acting as a server. The client will send
 * either unicast or multicast packets to the server which will reply the packet
 * back to the originator.
 *
 * In this sample application we create four threads that start to send data.
 * This might not be what you want to do in your app so caveat emptor.
 */

#include <zephyr/logging/log.h>
LOG_MODULE_REGISTER(net_echo_client_sample, LOG_LEVEL_DBG);

#include <zephyr/zephyr.h>
#include <errno.h>
#include <stdio.h>
#include <stdlib.h>

#include <zephyr/net/socket.h>
#include <zephyr/net/tls_credentials.h>

#include <zephyr/net/net_mgmt.h>
#include <zephyr/net/net_event.h>
#include <zephyr/net/net_conn_mgr.h>

#if defined(CONFIG_USERSPACE)
#include <zephyr/app_memory/app_memdomain.h>
K_APPMEM_PARTITION_DEFINE(app_partition);
struct k_mem_domain app_domain;
#endif

#include "common.h"
#define APP_BANNER "Run echo client"

#define INVALID_SOCK (-1)

#define EVENT_MASK (NET_EVENT_L4_CONNECTED | \
		    NET_EVENT_L4_DISCONNECTED)

/* Generated by http://www.lipsum.com/
 * 2 paragraphs, 179 words, 1160 bytes of Lorem Ipsum
 */
char packet_buffer[] ="\0\0\0\0\0\0\0\0\0\0\0\0\0\0\0\0\0\0\0\0\0\0\0\0\0\0\0\0\0\0\0\0\0\0\0\0\0\0\0\0\0\0\0\0\0\0\0\0\0\0\0\0\0\0\0\0\0\0\0\0\0\0\0\0\0\0\0\0\0\0\0\0\0\0\0\0\0\0\0\0\0\0\0\0";
int buffer_len = sizeof(packet_buffer) - 1;

APP_DMEM struct configs conf = {
	.ipv6 = {
		.proto = "IPv6",
		.udp.sock = INVALID_SOCK,
	},
};

static APP_BMEM struct pollfd fd;

static APP_BMEM bool connected;
K_SEM_DEFINE(run_app, 0, 1);

static struct net_mgmt_event_callback mgmt_cb;

static void wait(void)
{
	/* Wait for event on any socket used. Once event occurs,
	 * we'll check them all.
	 */
	if (poll(&fd, 1, -1) < 0) {
		LOG_ERR("Error in poll:%d", errno);
	}
}

static int start_udp_and_tcp(void)
{
	int ret;

	LOG_INF("Starting...");

	if (IS_ENABLED(CONFIG_NET_UDP)) {
		ret = start_udp();
		if (ret < 0) {
			return ret;
		}
	}

	if (conf.ipv6.udp.sock >= 0) {
		fd.fd = conf.ipv6.udp.sock;
		fd.events = POLLIN;
	}

	return 0;
}

int send_sensor_values(void)
{
	int ret;

	wait();
	
	int lux_value = get_lux_value(0);
	int pir_value = get_pir_value(0);
	bme680_sensor_data_t sensor_data;
	bme680_get_sensor_data(&sensor_data);

	if (lux_value > 0) {
		wait();
		// TODO adjust to your packet structure/serializing logic
		//memcpy(packet_buffer, &lux_value, sizeof(lux_value)); 
		//buffer_len = sizeof(lux_value) - 1;
		sprintf((char*)&packet_buffer, "lux:%i;pir:%i;T:%d.%.2i;P:%d.%.2i;H:%d.%.2i;G:%d.%.2i\n",
				lux_value, pir_value,
				sensor_data.temp.val1, sensor_data.temp.val2, 
				sensor_data.press.val1, sensor_data.press.val2,
				sensor_data.humidity.val1, sensor_data.humidity.val2, 
				sensor_data.gas_res.val1, sensor_data.gas_res.val2);
		//buffer_len = strlen((char*)&packet_buffer);
		NET_INFO("Sending: %s\n", packet_buffer);
		//LOG_DBG("Set %d bytes, value %d", sizeof(lux_value), * (int *) &packet_buffer[0]);
		ret = process_udp();
	//}
	//
	//if (IS_ENABLED(CONFIG_NET_UDP)) {
	//	wait();
	//	ret = process_udp();
		if (ret < 0) {
			return ret;
		}
	}

	return 0;
}

static void stop_udp_and_tcp(void)
{
	LOG_INF("Stopping...");

	if (IS_ENABLED(CONFIG_NET_UDP)) {
		stop_udp();
	}
}

static void event_handler(struct net_mgmt_event_callback *cb,
			  uint32_t mgmt_event, struct net_if *iface)
{
	if ((mgmt_event & EVENT_MASK) != mgmt_event) {
		return;
	}

	if (mgmt_event == NET_EVENT_L4_CONNECTED) {
		LOG_INF("Network connected");

		connected = true;
		conf.ipv6.udp.mtu = net_if_get_mtu(iface);
		k_sem_give(&run_app);

		return;
	}

	if (mgmt_event == NET_EVENT_L4_DISCONNECTED) {
		LOG_INF("Network disconnected");

		connected = false;
		k_sem_reset(&run_app);

		return;
	}
}

static void init_app(void)
{
	LOG_INF(APP_BANNER);

#if defined(CONFIG_USERSPACE)
	struct k_mem_partition *parts[] = {
		&app_partition
	};

	int ret = k_mem_domain_init(&app_domain, ARRAY_SIZE(parts), parts);

	__ASSERT(ret == 0, "k_mem_domain_init() failed %d", ret);
	ARG_UNUSED(ret);
#endif

	if (IS_ENABLED(CONFIG_NET_CONNECTION_MANAGER)) {
		net_mgmt_init_event_callback(&mgmt_cb,
					     event_handler, EVENT_MASK);
		net_mgmt_add_event_callback(&mgmt_cb);

		net_conn_mgr_resend_status();
	}
}

static int start_client(void)
{
	int iterations = 1;
	int i = 0;
	int ret;

	while (iterations == 0 || i < iterations) {
		/* Wait for the connection. */
		k_sem_take(&run_app, K_FOREVER);

		ret = start_udp_and_tcp();

		if(ret == 0)
		{
			do
			{
				/* code */
				ret =	pir_init();

				k_sleep(K_MSEC(1000));
			} while (ret != 0);
		
		}

		while (connected && (ret == 0)) {
			ret = send_sensor_values();
			k_sleep(K_MSEC(5000));
		}

		stop_udp_and_tcp();
	}

	return ret;
}

void main(void)
{
	init_app();

	if (!IS_ENABLED(CONFIG_NET_CONNECTION_MANAGER)) {
		/* If the config library has not been configured to start the
		 * app only after we have a connection, then we can start
		 * it right away.
		 */
		k_sem_give(&run_app);
	}

	k_thread_priority_set(k_current_get(), THREAD_PRIORITY);

#if defined(CONFIG_USERSPACE)
	k_thread_access_grant(k_current_get(), &run_app);
	k_mem_domain_add_thread(&app_domain, k_current_get());

	k_thread_user_mode_enter((k_thread_entry_t)start_client, NULL, NULL,
				 NULL);
#else
	exit(start_client());
#endif
}
```

## src/pir.c
```c
/*
 * Copyright (c) 2016 Open-RnD Sp. z o.o.
 * Copyright (c) 2020 Nordic Semiconductor ASA
 *
 * SPDX-License-Identifier: Apache-2.0
 */

#include <zephyr/zephyr.h>
#include <zephyr/device.h>
#include <zephyr/drivers/gpio.h>
#include <zephyr/sys/util.h>
#include <zephyr/sys/printk.h>
#include <inttypes.h>

#include "common.h"

#include <logging/log.h>
LOG_MODULE_DECLARE(net_echo_client_sample, LOG_LEVEL_DBG);

/*
 * Get pir_sensor configuration from the devicetree sw0 alias. This is mandatory.
 */
#define PIR0_NODE	DT_ALIAS(pir0)
#if !DT_NODE_HAS_STATUS(PIR0_NODE, okay)
#error "Unsupported board: sw0 devicetree alias is not defined"
#endif
static const struct gpio_dt_spec pir_sensor = GPIO_DT_SPEC_GET_OR(PIR0_NODE, gpios,
							      {0});
static struct gpio_callback button_cb_data;

void pir_changed(const struct device *dev, struct gpio_callback *cb,
		    uint32_t pins)
{
    int value = gpio_pin_get(pir_sensor.port, pir_sensor.pin);
	LOG_DBG("Intr:  PIR value: %i, Dev: %s, Pin %i\n", value,pir_sensor.port->name, pir_sensor.pin);
	(void) send_sensor_values();
}


int get_pir_value(uint8_t pin)
{
    int value = gpio_pin_get(pir_sensor.port, pir_sensor.pin);
	LOG_DBG("PIR value: %i, Dev: %s, Pin %i\n", value,pir_sensor.port->name, pir_sensor.pin);
    return value;
}

int pir_init(void)
{
	int ret=device_is_ready(pir_sensor.port);

	if (!ret) {
		LOG_ERR("Error: pir_sensor device %s is not ready\n",
		       pir_sensor.port->name);
		return ret;
	}

	ret = gpio_pin_configure_dt(&pir_sensor, GPIO_INPUT);
	if (ret != 0) {
		LOG_ERR("Error %d: failed to configure %s pin %d\n",
		       ret, pir_sensor.port->name, pir_sensor.pin);
		return ret;
	}
	/*
	ret = gpio_pin_interrupt_configure_dt(&pir_sensor,
					      GPIO_INT_EDGE_BOTH);
	if (ret != 0) {
		LOG_ERR("Error %d: failed to configure interrupt on %s pin %d\n",
			ret, pir_sensor.port->name, pir_sensor.pin);
		return ret;
	}

	gpio_init_callback(&button_cb_data, pir_changed, BIT(pir_sensor.pin));
	gpio_add_callback(pir_sensor.port, &button_cb_data);
	*/
	LOG_INF("Set up pir_sensor at %s pin %d\n", pir_sensor.port->name, pir_sensor.pin);

	return 0;
}
```

## src/sensors.c
```c
/*
 * Copyright (c) 2016 Open-RnD Sp. z o.o.
 * Copyright (c) 2020 Nordic Semiconductor ASA
 *
 * SPDX-License-Identifier: Apache-2.0
 */

#include <zephyr/zephyr.h>
#include <zephyr/device.h>
#include <zephyr/drivers/gpio.h>
#include <zephyr/drivers/sensor.h>
#include <zephyr/drivers/adc.h>

#include <zephyr/sys/util.h>
#include <zephyr/sys/printk.h>
#include <inttypes.h>

#include <stdio.h>
#include <math.h>
#include "common.h"

#include <logging/log.h>
LOG_MODULE_REGISTER(sensors, LOG_LEVEL_DBG);

//--------------------------------------------------------
// Alias definitions 
//--------------------------------------------------------
/*
 * Get pir_sensor configuration from the devicetree sw0 alias. This is mandatory.
 */
#define PIR0_NODE	DT_ALIAS(pir0)
#if !DT_NODE_HAS_STATUS(PIR0_NODE, okay)
#error "Unsupported board: sw0 devicetree alias is not defined"
#endif
static const struct gpio_dt_spec pir_sensor = GPIO_DT_SPEC_GET_OR(PIR0_NODE, gpios,
							      {0});
static struct gpio_callback button_cb_data;


#if !DT_NODE_EXISTS(DT_PATH(zephyr_user)) || \
	!DT_NODE_HAS_PROP(DT_PATH(zephyr_user), io_channels)
#error "No suitable devicetree overlay specified"
#endif

#define ADC_NUM_CHANNELS	DT_PROP_LEN(DT_PATH(zephyr_user), io_channels)

#if ADC_NUM_CHANNELS > 2
#error "Currently only 1 or 2 channels supported"
#endif

#if ADC_NUM_CHANNELS == 2 && !DT_SAME_NODE( \
	DT_PHANDLE_BY_IDX(DT_PATH(zephyr_user), io_channels, 0), \
	DT_PHANDLE_BY_IDX(DT_PATH(zephyr_user), io_channels, 1))
#error "Channels have to use the same ADC."
#endif

#define ADC_NODE		DT_PHANDLE(DT_PATH(zephyr_user), io_channels)

/* Common settings supported by most ADCs */
#define ADC_RESOLUTION		12
#define ADC_GAIN		ADC_GAIN_1
#define ADC_REFERENCE		ADC_REF_INTERNAL
#define ADC_ACQUISITION_TIME	ADC_ACQ_TIME_DEFAULT

#ifdef CONFIG_ADC_NRFX_SAADC
#define ADC_INPUT_POS_OFFSET SAADC_CH_PSELP_PSELP_AnalogInput0
#else
#define ADC_INPUT_POS_OFFSET 0
#endif

//--------------------------------------------------------
// Static helper functions 
//--------------------------------------------------------

int get_luminance_value(uint8_t channel);
int pir_init(void);
int get_pir_value(void);
void bme680_get_sensor_data(sensor_data_t *sensor_data);
static void query_sensor_data(void);
void notify_observers(void);

//--------------------------------------------------------
// Runtime Variables 
//--------------------------------------------------------

static uint8_t current_id=0; 
static uint8_t last_id=1;
static sensor_data_t gathered_sensor_data[2];

/* Get the numbers of up to two channels */
static uint8_t channel_ids[ADC_NUM_CHANNELS] = {
	DT_IO_CHANNELS_INPUT_BY_IDX(DT_PATH(zephyr_user), 0),
#if ADC_NUM_CHANNELS == 2
	DT_IO_CHANNELS_INPUT_BY_IDX(DT_PATH(zephyr_user), 1)
#endif
};

static int16_t sample_buffer[ADC_NUM_CHANNELS];

struct adc_channel_cfg channel_cfg = {
	.gain = ADC_GAIN,
	.reference = ADC_REFERENCE,
	.acquisition_time = ADC_ACQUISITION_TIME,
	/* channel ID will be overwritten below */
	.channel_id = 0,
	.differential = 0
};

struct adc_sequence sequence = {
	/* individual channels will be added below */
	.channels    = 0,
	.buffer      = sample_buffer,
	/* buffer size in bytes, not number of samples */
	.buffer_size = sizeof(sample_buffer),
	.resolution  = ADC_RESOLUTION,
};

// Thread definitions to query the sensor data
K_THREAD_DEFINE(sensor_thread_id, STACK_SIZE,
		query_sensor_data, NULL, NULL, NULL,
		THREAD_PRIORITY,
		IS_ENABLED(CONFIG_USERSPACE) ? K_USER : 0, -1);

//--------------------------------------------------------
// Function Implementations
//--------------------------------------------------------

int sensors_init(void)
{
	int ret = pir_init();
	if(ret < 0)
	{
		return ret;
	}

	LOG_DBG("pir_init done");
#if defined(CONFIG_USERSPACE)
		k_mem_domain_add_thread(&app_domain, sensor_thread_id);	
#endif

	k_thread_name_set(sensor_thread_id, "sensors");
	k_thread_start(sensor_thread_id);

	return 0;
}

static void query_sensor_data(void)
{

	do
	{
		uint8_t temp_id=current_id;
		current_id = last_id;
		last_id=temp_id;

		// The interrupt for the PIR Sensor needs to be disabled, otherwise the 
		// I2C throws an error
		int ret = gpio_pin_interrupt_configure_dt(&pir_sensor,
					      GPIO_INT_DISABLE);
		if (ret != 0) {
			LOG_ERR("Error %d: failed to disable interrupt on %s pin %d\n",
				ret, pir_sensor.port->name, pir_sensor.pin);
			return;
		}

		gathered_sensor_data[current_id].luminance = get_luminance_value(0);
		gathered_sensor_data[current_id].presence =  get_pir_value();
		bme680_get_sensor_data(&gathered_sensor_data[current_id]);
		
		LOG_DBG("lux:%i;pir:%i;T:%d.%06d;P:%d.%06d;H:%d.%06d;AQI:%d\n",
				gathered_sensor_data[current_id].luminance, gathered_sensor_data[current_id].presence,
				gathered_sensor_data[current_id].temp.val1, gathered_sensor_data[current_id].temp.val2, 
				gathered_sensor_data[current_id].press.val1, gathered_sensor_data[current_id].press.val2,
				gathered_sensor_data[current_id].humidity.val1, gathered_sensor_data[current_id].humidity.val2, 
				gathered_sensor_data[current_id].air_quality_index);
		
		ret = gpio_pin_interrupt_configure_dt(&pir_sensor,
					      GPIO_INT_EDGE_BOTH);
		if (ret != 0) {
			LOG_ERR("Error %d: failed to enable interrupt on %s pin %d\n",
				ret, pir_sensor.port->name, pir_sensor.pin);
			return;
		}

		notify_observers();
		
		k_sleep(K_MSEC(5000));
	} while (true);
	
}

void notify_observers(void)
{
	int value_diff = gathered_sensor_data[current_id].temp.val1 - gathered_sensor_data[last_id].temp.val1;
	if(value_diff <= -1 || value_diff >= 1)
	{
		LOG_INF("Temperature changed:%d.%06d -%d.%06d", 
			gathered_sensor_data[current_id].temp.val1, gathered_sensor_data[current_id].temp.val2, 
			gathered_sensor_data[last_id].temp.val1, gathered_sensor_data[last_id].temp.val2 );
		coap_resource_update(COAP_RESOURCE_TEMPERATURE);
	}

	value_diff = gathered_sensor_data[current_id].humidity.val1 - gathered_sensor_data[last_id].humidity.val1;
	if(value_diff <= -1 || value_diff >= 1)
	{
		LOG_INF("Humidity changed: %d.%06d -%d.%06d", 
			gathered_sensor_data[current_id].humidity.val1, gathered_sensor_data[current_id].humidity.val2, 
			gathered_sensor_data[last_id].humidity.val1, gathered_sensor_data[last_id].humidity.val2 );
		coap_resource_update(COAP_RESOURCE_HUMIDITY);
	}

	value_diff = gathered_sensor_data[current_id].press.val1 - gathered_sensor_data[last_id].press.val1;
	if(value_diff <= -1 || value_diff >= 1)
	{
		LOG_INF("Air Pressure changed:%d.%06d -%d.%06d", 
			gathered_sensor_data[current_id].press.val1, gathered_sensor_data[current_id].press.val2, 
			gathered_sensor_data[last_id].press.val1, gathered_sensor_data[last_id].press.val2 );
		coap_resource_update(COAP_RESOURCE_AIR_PRESSURE);
	}

	value_diff = round(gathered_sensor_data[current_id].air_quality_index) - round(gathered_sensor_data[last_id].air_quality_index);
	if( value_diff <= -1 || value_diff >= 1)
	{
		LOG_INF("Air Quality changed:%d -%d", 
			gathered_sensor_data[current_id].air_quality_index,
			gathered_sensor_data[last_id].air_quality_index );
		coap_resource_update(COAP_RESOURCE_AIR_QUALITY);
	}

	value_diff = gathered_sensor_data[current_id].luminance - gathered_sensor_data[last_id].luminance;
	if(value_diff <= -1 || value_diff >= 1)
	{
		LOG_INF("Luminance changed: %d - %d", 
			gathered_sensor_data[current_id].luminance,
			gathered_sensor_data[last_id].luminance);
		coap_resource_update(COAP_RESOURCE_LUMINANCE);
	}

	value_diff = gathered_sensor_data[current_id].presence - gathered_sensor_data[last_id].presence;
	if(value_diff <= -1 || value_diff >= 1)
	{
		LOG_INF("Presence changed: %d - %d", 
			gathered_sensor_data[current_id].presence,
			gathered_sensor_data[last_id].presence);
		coap_resource_update(COAP_RESOURCE_PRESSENCE);
	}
}

void get_sensor_data(sensor_data_t *sensor_data)
{
	*sensor_data = gathered_sensor_data[current_id];
}


void pir_changed(const struct device *dev, struct gpio_callback *cb,
		    uint32_t pins)
{
    int value = gpio_pin_get(pir_sensor.port, pir_sensor.pin);
	LOG_DBG("Intr:  PIR value: %i, Dev: %s, Pin %i\n", value,pir_sensor.port->name, pir_sensor.pin);
	k_wakeup(sensor_thread_id);
}


int get_pir_value(void)
{
    int value = gpio_pin_get(pir_sensor.port, pir_sensor.pin);
    return value;
}

int pir_init(void)
{
	int ret=device_is_ready(pir_sensor.port);

	if (!ret) {
		LOG_ERR("Error: pir_sensor device %s is not ready\n",
		       pir_sensor.port->name);
		return ret;
	}

	ret = gpio_pin_configure_dt(&pir_sensor, GPIO_INPUT);
	if (ret != 0) {
		LOG_ERR("Error %d: failed to configure %s pin %d\n",
		       ret, pir_sensor.port->name, pir_sensor.pin);
		return ret;
	}
	
	ret = gpio_pin_interrupt_configure_dt(&pir_sensor,
					      GPIO_INT_EDGE_BOTH);
	if (ret != 0) {
		LOG_ERR("Error %d: failed to configure interrupt on %s pin %d\n",
			ret, pir_sensor.port->name, pir_sensor.pin);
		return ret;
	}

	gpio_init_callback(&button_cb_data, pir_changed, BIT(pir_sensor.pin));
	gpio_add_callback(pir_sensor.port, &button_cb_data);
	
	LOG_INF("Set up pir_sensor at %s pin %d\n", pir_sensor.port->name, pir_sensor.pin);

	return 0;
}


void bme680_get_sensor_data(sensor_data_t *sensor_data)
{
	const struct device *dev = device_get_binding(DT_LABEL(DT_INST(0, bosch_bme680)));
	LOG_DBG("Device %p name is %s\n", dev, dev->name);
	int ret = device_is_ready(dev);
	if(!ret )
	{
		LOG_ERR("Device %s is not ready \n",
		       dev->name);
		return;
	}
	
	ret = sensor_sample_fetch(dev);
	if(ret != 0)
	{
		LOG_ERR("Unable to fetch sensor sample of %s: %i \n",
		       dev->name, -ret);
		return;
	}
	
    ret = sensor_channel_get(dev, SENSOR_CHAN_AMBIENT_TEMP, &sensor_data->temp);
	if(ret != 0)
	{
		LOG_ERR("Unable to sensor data %i of %s: %i \n",
		       SENSOR_CHAN_AMBIENT_TEMP, dev->name, -ret);
		return;
	}
	
	ret = sensor_channel_get(dev, SENSOR_CHAN_PRESS, &sensor_data->press);
	if(ret != 0)
	{
		LOG_ERR("Unable to sensor data %i of %s: %i \n",
		       SENSOR_CHAN_PRESS, dev->name, -ret);
		return;
	}
	ret = sensor_channel_get(dev, SENSOR_CHAN_HUMIDITY, &sensor_data->humidity);
	if(ret != 0)
	{
		LOG_ERR("Unable to sensor data %i of %s: %i \n",
		       SENSOR_CHAN_HUMIDITY, dev->name, -ret);
		return;
	}

	struct sensor_value gas_res;
	ret = sensor_channel_get(dev, SENSOR_CHAN_GAS_RES, &gas_res);
	if(ret != 0)
	{
		LOG_ERR("Unable to sensor data for channle %i of %s: %i \n",
		       SENSOR_CHAN_GAS_RES, dev->name, -ret);
		return;
	}
	double gas_res_2 = sensor_value_to_double(&gas_res);
	// Using gas sensor resistance conversion found here
	//https://forums.pimoroni.com/t/bme680-observed-gas-ohms-readings/6608/17
	// C converts double to int automatically, decimal values not relevant for AQI
	sensor_data->air_quality_index = log(gas_res_2) + 0.4 * sensor_value_to_double(&sensor_data->humidity);
}

int get_luminance_value(uint8_t channel)
{
	int err;
	const struct device *dev_adc = DEVICE_DT_GET(ADC_NODE);

	if (!device_is_ready(dev_adc)) {
		LOG_ERR("ADC device not found");
		return -1;
	}

	if (channel > ADC_NUM_CHANNELS - 1) {
			LOG_ERR("Channel %d was not configured!", channel);
			return -1;
	}

	/*
	 * Configure channels individually prior to sampling
	 */
        channel_cfg.channel_id = channel_ids[channel];
#ifdef CONFIG_ADC_CONFIGURABLE_INPUTS
        channel_cfg.input_positive = ADC_INPUT_POS_OFFSET + channel_ids[channel];
#endif

	adc_channel_setup(dev_adc, &channel_cfg);

	sequence.channels |= BIT(channel_ids[channel]);

	/*
		* Read sequence of channels (fails if not supported by MCU)
		*/
	err = adc_read(dev_adc, &sequence);
	if (err != 0) {
		LOG_ERR("ADC reading failed with error %d", err);
		return -1;
	}

	int32_t raw_value = sample_buffer[channel];
	int32_t luminance_value = raw_value;

	LOG_DBG("ADC reading: %d", raw_value);
	
	// maximum value of luminance sensor is 350 lux
	// ADC has 12 bit resolution, approximate value
	// with ADC-value*350/4096
	luminance_value = raw_value * 350;
	luminance_value >>=12;	    
	
	return luminance_value;
	
}
```

## src/udp.c
```c
/* udp.c - UDP specific code for echo server */

/*
 * Copyright (c) 2017 Intel Corporation.
 * Copyright (c) 2018 Nordic Semiconductor ASA.
 *
 * SPDX-License-Identifier: Apache-2.0
 */

#include <zephyr/logging/log.h>
LOG_MODULE_DECLARE(net_echo_server_sample, LOG_LEVEL_DBG);

#include <zephyr/zephyr.h>
#include <errno.h>
#include <stdio.h>

#include <zephyr/net/socket.h>
#include <zephyr/net/tls_credentials.h>

#include "common.h"

static void process_udp6(void);

K_THREAD_DEFINE(udp6_thread_id, STACK_SIZE,
		process_udp6, NULL, NULL, NULL,
		THREAD_PRIORITY,
		IS_ENABLED(CONFIG_USERSPACE) ? K_USER : 0, -1);

static int start_udp_proto(struct data *data, struct sockaddr *bind_addr,
			   socklen_t bind_addrlen)
{
	int ret;

	data->udp.sock = socket(bind_addr->sa_family, SOCK_DGRAM, IPPROTO_UDP);

	if (data->udp.sock < 0) {
		NET_ERR("Failed to create UDP socket (%s): %d", data->proto,
			errno);
		return -errno;
	}

	ret = bind(data->udp.sock, bind_addr, bind_addrlen);
	if (ret < 0) {
		NET_ERR("Failed to bind UDP socket (%s): %d", data->proto,
			errno);
		ret = -errno;
	}

	return ret;
}

static int process_udp(struct data *data)
{
	int ret = 0;
	int received;
	struct sockaddr client_addr;
	socklen_t client_addr_len;

	NET_INFO("Waiting for UDP packets on port %d (%s)...",
		 MY_PORT, data->proto);

	do {
		client_addr_len = sizeof(client_addr);
		received = recvfrom(data->udp.sock, data->udp.recv_buffer,
				    sizeof(data->udp.recv_buffer), 0,
				    &client_addr, &client_addr_len);

		if (received < 0) {
			/* Socket error */
			NET_ERR("UDP (%s): Connection error %d", data->proto,
				errno);
			ret = -errno;
			break;
		} else if (received) {
			atomic_add(&data->udp.bytes_received, received);
		}
		NET_INFO("Received: %s\n", data->udp.recv_buffer);
		ret = sendto(data->udp.sock, data->udp.recv_buffer, received, 0,
			     &client_addr, client_addr_len);
		if (ret < 0) {
			NET_ERR("UDP (%s): Failed to send %d", data->proto,
				errno);
			ret = -errno;
			break;
		}

		if (++data->udp.counter % 1000 == 0U) {
			NET_INFO("%s UDP: Sent %u packets", data->proto,
				 data->udp.counter);
		}

		NET_DBG("UDP (%s): Received and replied with %d bytes",
			data->proto, received);
	} while (true);

	return ret;
}

static void process_udp6(void)
{
	int ret;
	struct sockaddr_in6 addr6;

	(void)memset(&addr6, 0, sizeof(addr6));
	addr6.sin6_family = AF_INET6;
	addr6.sin6_port = htons(MY_PORT);

	ret = start_udp_proto(&conf.ipv6, (struct sockaddr *)&addr6,
			      sizeof(addr6));
	if (ret < 0) {
		quit();
		return;
	}

	k_work_reschedule(&conf.ipv6.udp.stats_print, K_SECONDS(STATS_TIMER));

	while (ret == 0) {
		ret = process_udp(&conf.ipv6);
		if (ret < 0) {
			quit();
		}
	}
}

static void print_stats(struct k_work *work)
{
	struct k_work_delayable *dwork = k_work_delayable_from_work(work);
	struct data *data = CONTAINER_OF(dwork, struct data, udp.stats_print);
	int total_received = atomic_get(&data->udp.bytes_received);

	if (total_received) {
		if ((total_received / STATS_TIMER) < 1024) {
			LOG_INF("%s UDP: Received %d B/sec", data->proto,
				total_received / STATS_TIMER);
		} else {
			LOG_INF("%s UDP: Received %d KiB/sec", data->proto,
				total_received / 1024 / STATS_TIMER);
		}

		atomic_set(&data->udp.bytes_received, 0);
	}

	k_work_reschedule(&data->udp.stats_print, K_SECONDS(STATS_TIMER));
}

void start_udp(void)
{
	if (IS_ENABLED(CONFIG_NET_IPV6)) {
#if defined(CONFIG_USERSPACE)
		k_mem_domain_add_thread(&app_domain, udp6_thread_id);
#endif

		k_work_init_delayable(&conf.ipv6.udp.stats_print, print_stats);
		k_thread_name_set(udp6_thread_id, "udp6");
		k_thread_start(udp6_thread_id);
	}
}

void stop_udp(void)
{
	/* Not very graceful way to close a thread, but as we may be blocked
	 * in recvfrom call it seems to be necessary
	 */
	if (IS_ENABLED(CONFIG_NET_IPV6)) {
		k_thread_abort(udp6_thread_id);
		if (conf.ipv6.udp.sock >= 0) {
			(void)close(conf.ipv6.udp.sock);
		}
	}
}
```
